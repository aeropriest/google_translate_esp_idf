## main/Kconfig.projbuild
```kconfig
menu "Example Configuration"

config WIFI_SSID
    string "WiFi SSID"
	default ""
	help
		SSID (network name) for the example to connect to.

config WIFI_PASSWORD
    string "WiFi Password"
	default ""
	help
		WiFi password (WPA or WPA2) for the example to use.
		Can be left blank if the network has no security set.

config GOOGLE_API_KEY
    string "Google Cloud API Key"
    default ""
    help
        Google Cloud API Key

        The key may be obtained from https://cloud.google.com/docs/authentication/api-keys

endmenu
```
